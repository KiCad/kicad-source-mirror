/*
 * This program source code file is part of KiCad, a free EDA CAD application.
 *
 * Copyright (C) 2021 KiCad Developers, see AUTHORS.txt for contributors.
 *
 * This program is free software: you can redistribute it and/or modify it
 * under the terms of the GNU General Public License as published by the
 * Free Software Foundation, either version 3 of the License, or (at your
 * option) any later version.
 *
 * This program is distributed in the hope that it will be useful, but
 * WITHOUT ANY WARRANTY; without even the implied warranty of
 * MERCHANTABILITY or FITNESS FOR A PARTICULAR PURPOSE.  See the GNU
 * General Public License for more details.
 *
 * You should have received a copy of the GNU General Public License along
 * with this program.  If not, see <http://www.gnu.org/licenses/>.
 */

#include <wx/bitmap.h>
#include <wx/filename.h>
#include <wx/log.h>
#include <wx/mstream.h>
#include <wx/stdpaths.h>

#include <advanced_config.h>
#include <asset_archive.h>
#include <bitmaps.h>
#include <bitmap_store.h>
#include <bitmaps/bitmap_info.h>
#include <kiplatform/ui.h>
#include <paths.h>
#include <pgm_base.h>
#include <settings/common_settings.h>


/// A question-mark icon shown when we can't find a given bitmap in the archive
static const unsigned char s_imageNotFound[] = {
    0x89, 0x50, 0x4e, 0x47, 0x0d, 0x0a, 0x1a, 0x0a, 0x00, 0x00, 0x00, 0x0d, 0x49, 0x48, 0x44, 0x52,
    0x00, 0x00, 0x00, 0x18, 0x00, 0x00, 0x00, 0x18, 0x08, 0x04, 0x00, 0x00, 0x00, 0x4a, 0x7e, 0xf5,
    0x73, 0x00, 0x00, 0x01, 0xab, 0x49, 0x44, 0x41, 0x54, 0x38, 0xcb, 0x8d, 0xd4, 0x3f, 0x2c, 0x03,
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    0xae, 0x42, 0x60, 0x82,
};


/// Icon used for EDA_ITEMs that don't have a custom icon configured
/// @todo Replace this with an external file?
static const unsigned char s_dummyItem[] = {
    0x89, 0x50, 0x4e, 0x47, 0x0d, 0x0a, 0x1a, 0x0a, 0x00, 0x00, 0x00, 0x0d, 0x49, 0x48, 0x44, 0x52,
    0x00, 0x00, 0x00, 0x10, 0x00, 0x00, 0x00, 0x10, 0x08, 0x06, 0x00, 0x00, 0x00, 0x1f, 0xf3, 0xff,
    0x61, 0x00, 0x00, 0x00, 0x5f, 0x49, 0x44, 0x41, 0x54, 0x38, 0xcb, 0x63, 0xf8, 0xff, 0xff, 0x3f,
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    0x49, 0x45, 0x4e, 0x44, 0xae, 0x42, 0x60, 0x82,
};


static const wxString traceBitmaps = wxT( "KICAD_BITMAPS" );

static const wxString IMAGE_ARCHIVE = wxT( "images.tar.gz" );


size_t std::hash<std::pair<BITMAPS, int>>::operator()( const std::pair<BITMAPS, int>& aPair ) const
{
    return std::hash<int>()( static_cast<int>( aPair.first ) ^ std::hash<int>()( aPair.second ) );
}


BITMAP_STORE::BITMAP_STORE()
{
    wxFileName path( PATHS::GetStockDataPath() + wxT( "/resources" ), IMAGE_ARCHIVE );

    wxLogTrace( traceBitmaps, "Loading bitmaps from " + path.GetFullPath() );

    m_archive = std::make_unique<ASSET_ARCHIVE>( path.GetFullPath() );

    buildBitmapInfoCache();

    ThemeChanged();
}


wxBitmap BITMAP_STORE::GetBitmap( BITMAPS aBitmapId, int aHeight )
{
    return wxBitmap( getImage( aBitmapId, aHeight ) );
}


wxBitmap BITMAP_STORE::GetBitmapScaled( BITMAPS aBitmapId, int aScaleFactor, int aHeight )
{
    wxImage image = getImage( aBitmapId, aHeight );

    // Bilinear seems to genuinely look better for these line-drawing icons
    // than bicubic, despite claims in the wx documentation that bicubic is
    // "highest quality". I don't recommend changing this. Bicubic looks
    // blurry and makes me want an eye exam.
    image.Rescale( aScaleFactor * image.GetWidth() / 4, aScaleFactor * image.GetHeight() / 4,
                   wxIMAGE_QUALITY_BILINEAR );

    return wxBitmap( image );
}


wxImage BITMAP_STORE::getImage( BITMAPS aBitmapId, int aHeight )
{
    const unsigned char* data = nullptr;
    long count;

    if( aBitmapId == BITMAPS::dummy_item )
    {
        data  = s_dummyItem;
        count = sizeof( s_dummyItem );
    }
    else
    {
        count = m_archive->GetFilePointer( bitmapName( aBitmapId, aHeight ), &data );

        if( count < 0 )
        {
            data  = s_imageNotFound;
            count = sizeof( s_imageNotFound );
        }
    }

    wxMemoryInputStream is( data, count );
    wxImage image( is, wxBITMAP_TYPE_PNG );
    wxBitmap bitmap( image );

    return image;
}


bool BITMAP_STORE::ThemeChanged()
{
    COMMON_SETTINGS* settings = Pgm().GetCommonSettings();

    wxString oldTheme = m_theme;

    if( ADVANCED_CFG::GetCfg().m_AllowDarkMode )
    {
        switch( settings->m_Appearance.icon_theme )
        {
        case ICON_THEME::LIGHT:     m_theme = wxT( "light" );   break;
        case ICON_THEME::DARK:      m_theme = wxT( "dark" );    break;
        case ICON_THEME::AUTO:
            m_theme = KIPLATFORM::UI::IsDarkTheme() ? wxT( "dark" ) : wxT( "light" );
            break;
        }
    }
    else
    {
        m_theme = wxT( "light" );
    }

    m_bitmapNameCache.clear();

    return !oldTheme.IsSameAs( m_theme );
}


const wxString& BITMAP_STORE::bitmapName( BITMAPS aBitmapId, int aHeight )
{
    std::pair<BITMAPS, int> key = std::make_pair( aBitmapId, aHeight );

    if( !m_bitmapNameCache.count( key ) )
        m_bitmapNameCache[key] = computeBitmapName( aBitmapId, aHeight );

    return m_bitmapNameCache.at( key );
}


wxString BITMAP_STORE::computeBitmapName( BITMAPS aBitmapId, int aHeight )
{
    if( !m_bitmapInfoCache.count( aBitmapId ) )
    {
        wxLogTrace( traceBitmaps, "No bitmap info available for %d", aBitmapId );
        return wxEmptyString;
    }

    wxString fn;

    for( const BITMAP_INFO& info : m_bitmapInfoCache.at( aBitmapId ) )
    {
        if( info.theme != m_theme )
            continue;

        if( aHeight < 0 || info.height == aHeight )
        {
            fn = info.filename;
            break;
        }
    }

    if( fn.IsEmpty() )
    {
        wxLogTrace( traceBitmaps, "No bitmap found matching ID %d, height %d, theme %s",
                    aBitmapId, aHeight, m_theme );
        return m_bitmapInfoCache.at( aBitmapId ).begin()->filename;
    }

    return fn;
}


void BITMAP_STORE::buildBitmapInfoCache()
{
    for( const BITMAP_INFO& entry : g_BitmapInfo )
        m_bitmapInfoCache[entry.id].emplace_back( entry );
}
